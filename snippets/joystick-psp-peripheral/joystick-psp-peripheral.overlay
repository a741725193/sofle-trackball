/ {
    split_inputs {
        #address-cells = <1>;
        #size-cells = <0>;

        joystick_split: joystick_split@1 {
            compatible = "zmk,input-split";
            reg = <1>;
            device = <&psp_joystick>;
        };
    };
};
