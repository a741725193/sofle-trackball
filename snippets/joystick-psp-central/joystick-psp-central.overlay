#include <dt-bindings/zmk/keys.h>
#include <zephyr/dt-bindings/input/input-event-codes.h>

/ {
    input_processors {
        psp_arrow_behaviors: psp_arrow_behaviors {
            compatible = "zmk,input-processor-behaviors";
            #input-processor-cells = <0>;
            codes = <INPUT_KEY_UP INPUT_KEY_DOWN INPUT_KEY_LEFT INPUT_KEY_RIGHT>;
            bindings = <&kp UP &kp DOWN &kp LEFT &kp RIGHT>;
        };
    };

    psp_joystick_listener: psp_joystick_listener {
        compatible = "zmk,input-listener";
        device = <&psp_joystick>;
        input-processors = <&psp_arrow_behaviors>;
    };
};
