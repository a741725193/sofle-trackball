/ {
    split_inputs {
        #address-cells = <1>;
        #size-cells = <0>;

        pointer_split: pointer_split@0 {
            compatible = "zmk,input-split";
            reg = <0>;
            device = <&tps43>;
        };
    };
};
